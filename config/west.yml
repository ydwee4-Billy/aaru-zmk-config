## config/west.yml
```yaml
manifest:
  remotes:
    - name: luantty2
      url-base: https://github.com/luantty2
  projects:
    - name: zmk
      remote: luantty2
      revision: aaru-max17048-indicator
      import: app/west.yml
  self:
    path: config
```
